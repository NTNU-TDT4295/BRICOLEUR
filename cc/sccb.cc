#include <array>
#include <vector>
#include <thread>
#include <chrono>

#include <fmt/format.h>

#include <linux/i2c.h>
#include <linux/i2c-dev.h>
#include <sys/fcntl.h>
#include <sys/ioctl.h>
#include <unistd.h>

/*
   0x4300 Format - 0x61 rgb565, 0x25 rgb888

   0x3017 Pad output enable 1
   0x3018 Pad output enable 2

   Scaling
   0x5001 bit[4] horizontal, bit[5] vertical

   Image windowing
   0x3800 Timing horizontal start high
   0x3801 Timing horizontal start low
   0x3802 Timing vertical start high
   0x3803 Timing vertical start low

   0x3804 Timing horizontal width high
   0x3805 Timing horizontal width low
   0x3806 Timing vertical width high
   0x3807 Timing vertical width low

   DVP
   0x3808 DVP timing horizontal high
   0x3809 DVP timing horizontal low
   0x380a DVP timing vertical high
   0x380b DVP timing vertical low

   0x4713 Compression Select
   0x4740 Polarity
   0x4741 Test pattern
   0x4745 Data order

   Clock
   0x3009 PLL pre-divider step
   0x300a PLL pre-divider mod
   0x3103 PCLK select

*/
static constexpr auto DEVICE = "/dev/i2c-0";

using namespace std::chrono_literals;

struct regval { uint16_t addr; uint8_t val; };
extern const std::vector<regval> timings;

int sccb_read(int i2c, uint16_t address) {
	uint8_t data;
	uint8_t address_bytes[2];
	address_bytes[1] = address & 0xff;
	address_bytes[0] = address >> 8;

	std::array<i2c_msg, 2> messages {{
		{ 0x3c, 0, 2, &address_bytes[0] },
		{ 0x3c, 1, 1, &data }
	}};

	i2c_rdwr_ioctl_data message_set = {
		messages.data(),
		messages.size()
	};

	int err = ioctl(i2c, I2C_RDWR, &message_set);
	return err >= 0 ? data : -1;
}

bool sccb_write(int i2c, uint16_t address, uint8_t data) {
	uint8_t address_bytes[2];
	address_bytes[1] = address & 0xff;
	address_bytes[0] = address >> 8;

	std::array<i2c_msg, 2> messages {{
		{ 0x3c, 0, 2, &address_bytes[0] },
		{ 0x3c, 0, 1, &data }
	}};

	i2c_rdwr_ioctl_data message_set = {
		messages.data(),
		messages.size()
	};

	int err = ioctl(i2c, I2C_RDWR, &message_set);
	return err >= 0;
}

const auto usage =
	"Use it correctly\n"
	"sccb r <addr>  or  sccb w <addr> <val>  or  sccb t\n"
;

int main(int argc, char **argv) {
	if(argc < 2) {
		fmt::print("{}", usage);
		exit(1);
	}

	const int file = open(DEVICE, O_RDWR);
	if(file < 0) {
		fmt::print("Error opening {}\n", DEVICE);
		exit(1);
	}

	enum class mode { read, write, test, invalid };
	const auto mode = [arg0 = argv[1]] {
		switch(arg0[0]) {
			case 'r':
				return mode::read;
			case 'w':
				return mode::write;
			case 't':
				return mode::test;
			default:
				return mode::invalid;
		}
	}();

	if(
		mode == mode::invalid ||
		(mode == mode::read && argc < 3) ||
		(mode == mode::write && argc < 4)
	) {
		fmt::print("{}", usage);
		exit(1);
	}

	if(mode == mode::read) {
		const uint16_t addr = strtoul(argv[2], nullptr, 16);
		fmt::print("r {:04x}: {:x}\n", addr, sccb_read(file, addr));
	} else if(mode == mode::write) {
		const uint16_t addr = strtoul(argv[2], nullptr, 16);
		const uint8_t data = strtoul(argv[3], nullptr, 16);
		const auto err = sccb_write(file, addr, data);
		if(!err) fmt::print("Error writing to {:x}\n", addr);
	} else if(mode == mode::test) {
		for(const auto &entry : timings) {
			bool success = false;
			int attempts = 0;
			fmt::print("Setting {:x} to {:x} ", entry.addr, entry.val);
			do {
				std::this_thread::sleep_for(10ms);
				sccb_write(file, entry.addr, entry.val);
				std::this_thread::sleep_for(10ms);
				success = sccb_read(file, entry.addr) == entry.val;
				if(!success) fmt::print(".");
				attempts++;
			} while(!success && attempts < 5);
			fmt::print("\n");
		}
	}

	close(file);
}

static constexpr int scale = 1;
//static constexpr uint16_t width = 2592;
//static constexpr uint16_t height = 1944;
//static constexpr uint16_t width = 320;
//static constexpr uint16_t height = 240;
static constexpr uint16_t width = 640;
static constexpr uint16_t height = 480;
static constexpr uint16_t sensor_width = width * 1;
static constexpr uint16_t sensor_height = height * 1;
static constexpr uint16_t total_width = width + 524;
static constexpr uint16_t total_height = std::max(height + 56, 1000);

const std::vector<regval> timings =
{
	//{ 0x3800 , 0 }, // Timing horizontal start high
   	//{ 0x3801 , 0 }, // Timing horizontal start low
   	//{ 0x3802 , 0 }, // Timing vertical start high
   	//{ 0x3803 , 0 }, // Timing vertical start low

	//{ 0x5001 , 0x11 }, // Horizontal scale

#if 1
   	{ 0x3804 , sensor_width >> 8 },    // Timing horizontal width high
   	{ 0x3805 , sensor_width & 0xff },  // Timing horizontal width low
   	{ 0x3806 , sensor_height >> 8 },   // Timing vertical width high
   	{ 0x3807 , sensor_height & 0xff }, // Timing vertical width low

   	{ 0x3808 , width >> 8 },   // DVP timing horizontal high
   	{ 0x3809 , width & 0xff }, // DVP timing horizontal low
   	{ 0x380a , height >> 8 },  // DVP timing vertical high
   	{ 0x380b , height & 0xff },// DVP timing vertical low

   	{ 0x380c , total_width >> 8 },   // Total timing horizontal high
   	{ 0x380d , total_width & 0xff }, // Total timing horizontal low
   	{ 0x380e , total_height >> 8 },  // Total timing vertical high
   	{ 0x380f , total_height & 0xff },// Total timing vertical low

   	{ 0x5682 , sensor_width >> 8 },    // AWB horizontal width high
   	{ 0x5683 , sensor_width & 0xff },  // AWB horizontal width low
   	{ 0x5686 , sensor_height >> 8 },   // AWB vertical width high
   	{ 0x5687 , sensor_height & 0xff }, // AWB vertical width low
#endif

#if 0
 {0x3103, 0x93},
 {0x3008, 0x02},
 {0x3017, 0x7f},
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 {0x3007, 0x37},

 /* PLL 26Mhz91Mhz */
 {0x3011, 0x07},
 {0x3010, 0x00},

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 {0x3620, 0x52},

 /* flip and mirror */
 {0x3818, 0xa1},
 {0x3621, 0xa7},

 /* clock set */
 {0x3011 , 0x09},
 {0x3010 , 0x11},

 /*binning */
 {0x380c, 0x07},
 {0x380d, 0x0a},
 {0x3815, 0x03},
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 {0x380b, 0xf0},
#endif
}; 
